## layers/meta-techleef-bsp/conf/machine/techleef-bsp.conf
```bitbake
#@TYPE: Machine
#@NAME: raspberrypi02w_64-yocto machine
#@TYPE: Machine
require conf/machine/raspberrypi0-2w.conf
ENABLE_UART = "1"
ENABLE_I2C = "1"
ENABLE_UART = "1"

RPI_EXTRA_CONFIG += '\n\
# --- Boot optimizations ---\n\
disable_splash=1     # remove rainbow splash screen\n\
boot_delay=0         # start immediately with no boot delay\n\
\n\
# --- Display settings (disabled, since system is headless) ---\n\
disable_overscan=1   # no black borders (HDMI output off)\n\
hdmi_blanking=2      # disable HDMI entirely to save power\n\
\n\
# --- GPU memory allocation ---\n\
gpu_mem=16           # minimal memory reserved for GPU\n\
\n\
# --- Disable unused peripherals ---\n\
dtparam=audio=off    # disable audio hardware\n\
start_x=0            # disable camera firmware support\n\
'
RPI_USE_U_BOOT = "1"
```
